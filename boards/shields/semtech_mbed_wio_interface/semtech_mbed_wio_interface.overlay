/*
 * Copyright (c) 2025 Semtech Corporation
 *
 * SPDX-License-Identifier: Apache-2.0
 */

// Maps the xiao interface to the Arduino interface.

/ {
    xiao_d: connectorXiao {
        compatible = "semtech,mbed-wio-interface";
        #gpio-cells = <2>;
        gpio-map-mask = <0xffffffff 0xffffffc0>;
        gpio-map-pass-thru = <0 0x3f>;
        gpio-map = <0 0 &arduino_header 1 0>, /* D0 connected to A1 */
                   <1 0 &arduino_header 9 0>, /* D1 connected to D3 */
                   <2 0 &arduino_header 0 0>, /* D2 connected to A0 */
                   <3 0 &arduino_header 13 0>, /* D3 connected to D7 */
                   <4 0 &arduino_header 15 0>, /* D4 connected to D9 */
                   <5 0 &arduino_header 21 0>, /* D5 connected to D15 */
                   <6 0 &arduino_header 3 0>, /* D6 connected to A3 */
                   <7 0 &arduino_header 14 0>, /* D7 connected to D8 */
                   <8 0 &arduino_header 19 0>, /* D8 connected to D13 */
                   <9 0 &arduino_header 18 0>, /* D9 connected to D12 */
                   <10 0 &arduino_header 17 0>;    /* D10 connected to D11 */
    };
};

xiao_spi: &arduino_spi {};
xiao_i2c: &arduino_i2c {};
