/*
 * Copyright (c) 2026 Semtech Corporation
 *
 * SPDX-License-Identifier: Apache-2.0
 */

#include "semtech_wio_lr20xx_common.dtsi"
#include "semtech_wio_lr20xx_region_eu_us.dtsi"

lora_semtech_wio_lr2012: &lora_semtech_wio_lr20xx {
	compatible = "semtech,lr2012";
};