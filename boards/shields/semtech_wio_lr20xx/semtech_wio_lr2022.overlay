/*
 * Copyright (c) 2025 Semtech Corporation
 *
 * SPDX-License-Identifier: Apache-2.0
 */

#include "semtech_wio_lr20xx_common.dtsi"
#include "semtech_wio_lr20xx_region_eu_us.dtsi"

lora_semtech_wio_lr2022: &lora_semtech_wio_lr20xx {
	compatible = "semtech,lr2022";
};