/*
 * Copyright (c) 2025 Semtech Corporation
 *
 * SPDX-License-Identifier: Apache-2.0
 */

&lora_semtech_wio_lr20xx {
	/* meas @490MHz */
	tx-power-cfg-lf =
	<(  2) 0x01 0x02>, /* Expected output power = -10dBm */
	<(  2) 0x02 0x01>, /* Expected output power = -9dBm */
	<(  4) 0x02 0x01>, /* Expected output power = -8dBm */
	<( 12) 0x01 0x01>, /* Expected output power = -7dBm */
	<( 14) 0x02 0x00>, /* Expected output power = -6dBm */
	<(  6) 0x03 0x01>, /* Expected output power = -5dBm */
	<( 24) 0x00 0x00>, /* Expected output power = -4dBm */
	<( 24) 0x01 0x00>, /* Expected output power = -3dBm */
	<( 28) 0x01 0x00>, /* Expected output power = -2dBm */
	<( 22) 0x02 0x00>, /* Expected output power = -1dBm */
	<( 12) 0x03 0x04>, /* Expected output power = 0dBm */
	<( 30) 0x00 0x01>, /* Expected output power = 1dBm */
	<( 18) 0x04 0x00>, /* Expected output power = 2dBm */
	<( 32) 0x00 0x02>, /* Expected output power = 3dBm */
	<( 22) 0x03 0x01>, /* Expected output power = 4dBm */
	<( 32) 0x03 0x00>, /* Expected output power = 5dBm */
	<( 28) 0x04 0x00>, /* Expected output power = 6dBm */
	<( 26) 0x04 0x01>, /* Expected output power = 7dBm */
	<( 28) 0x03 0x03>, /* Expected output power = 8dBm */
	<( 34) 0x03 0x02>, /* Expected output power = 9dBm */
	<( 30) 0x05 0x01>, /* Expected output power = 10dBm */
	<( 30) 0x04 0x05>, /* Expected output power = 11dBm */
	<( 30) 0x06 0x02>, /* Expected output power = 12dBm */
	<( 30) 0x07 0x02>, /* Expected output power = 13dBm */
	<( 30) 0x07 0x05>, /* Expected output power = 14dBm */
	<( 32) 0x07 0x05>, /* Expected output power = 15dBm */
	<( 36) 0x06 0x05>, /* Expected output power = 16dBm */
	<( 38) 0x06 0x05>, /* Expected output power = 17dBm */
	<( 38) 0x07 0x06>, /* Expected output power = 18dBm */
	<( 40) 0x07 0x06>, /* Expected output power = 19dBm */
	<( 42) 0x07 0x07>, /* Expected output power = 20dBm */
	<( 44) 0x07 0x07>, /* Expected output power = 21dBm */
	<( 44) 0x07 0x07>; /* Expected output power = 22dBm */

	tx-power-cfg-hf =
	/* half_power, pa_duty_cycle, pa_hp_sel */
	/* meas @2445MHz */
	<(-39) 28   0x07>, /* Expected output power = -17dBm */
	<(-38) 18   0x07>, /* Expected output power = -16dBm */
	<(-35) 19   0x07>, /* Expected output power = -15dBm */
	<(-31) 24   0x07>, /* Expected output power = -14dBm */
	<(-29) 19   0x07>, /* Expected output power = -13dBm */
	<(-26) 24   0x07>, /* Expected output power = -12dBm */
	<(-24) 17   0x07>, /* Expected output power = -11dBm */
	<(-21) 23   0x07>, /* Expected output power = -10dBm */
	<(-19) 18   0x07>, /* Expected output power = -9dBm */
	<(-17) 16   0x07>, /* Expected output power = -8dBm */
	<(-14) 21   0x07>, /* Expected output power = -7dBm */
	<(-12) 18   0x07>, /* Expected output power = -6dBm */
	<(-10) 16   0x07>, /* Expected output power = -5dBm */
	<( -8) 16   0x07>, /* Expected output power = -4dBm */
	<( -5) 24   0x07>, /* Expected output power = -3dBm */
	<( -2) 27   0x07>, /* Expected output power = -2dBm */
	<(  1) 29   0x07>, /* Expected output power = -1dBm */
	<(  2) 26   0x07>, /* Expected output power = 0dBm */
	<(  4) 25   0x07>, /* Expected output power = 1dBm */
	<(  7) 28   0x07>, /* Expected output power = 2dBm */
	<(  8) 20   0x07>, /* Expected output power = 3dBm */
	<( 11) 28   0x07>, /* Expected output power = 4dBm */
	<( 13) 27   0x07>, /* Expected output power = 5dBm */
	<( 16) 30   0x07>, /* Expected output power = 6dBm */
	<( 17) 28   0x07>, /* Expected output power = 7dBm */
	<( 17) 16   0x07>, /* Expected output power = 8dBm */
	<( 22) 30   0x07>, /* Expected output power = 9dBm */
	<( 24) 30   0x07>, /* Expected output power = 10dBm */
	<( 24) 26   0x07>, /* Expected output power = 11dBm */
	<( 24) 16   0x07>; /* Expected output power = 12dBm */

	// Power consumptions tables
	// DC/DC mode, LF path
	/* meas @490MHz */
	tx-dbm-to-ua-reg-mode-dcdc-lf-vreg = <
		6680    /* -10 dBm */
		6640    /*  -9 dBm */
		6760    /*  -8 dBm */
		6910    /*  -7 dBm */
		6950    /*  -6 dBm */
		7390    /*  -5 dBm */
		7100    /*  -4 dBm */
		7400    /*  -3 dBm */
		7640    /*  -2 dBm */
		8090    /*  -1 dBm */
		9530    /*   0 dBm */
		8880    /*   1 dBm */
		9470    /*   2 dBm */
		10000   /*   3 dBm */
		10510   /*   4 dBm */
		11050   /*   5 dBm */
		11630   /*   6 dBm */
		12650   /*   7 dBm */
		13850   /*   8 dBm */
		15540   /*   9 dBm */
		15760   /*  10 dBm */
		18190   /*  11 dBm */
		19300   /*  12 dBm */
		21300   /*  13 dBm */
		24950   /*  14 dBm */
		28470   /*  15 dBm */
		34480   /*  16 dBm */
		42050   /*  17 dBm */
		48390   /*  18 dBm */
		57470   /*  19 dBm */
		70760   /*  20 dBm */
		85590   /*  21 dBm */
		85590   /*  22 dBm  : not yet available */
	>;

	// DC/DC mode, HF path
	/* meas @2445MHz */
	tx-dbm-to-ua-reg-mode-dcdc-hf-vreg = <
		8090   /* -17 dBm */
		8320   /* -16 dBm */
		8340   /* -15 dBm */
		8500   /* -14 dBm */
		8660   /* -13 dBm */
		8620   /* -12 dBm */
		8880   /* -11 dBm */
		9010   /* -10 dBm */
		9220   /*  -9 dBm */
		9280   /*  -8 dBm */
		9440   /*  -7 dBm */
		10000  /*  -6 dBm */
		10330  /*  -5 dBm */
		10640  /*  -4 dBm */
		10380  /*  -3 dBm */
		10670  /*  -2 dBm */
		10490  /*  -1 dBm */
		12300  /*   0 dBm */
		12300  /*   1 dBm */
		12160  /*   2 dBm */
		12670  /*   3 dBm */
		13250  /*   4 dBm */
		13800  /*   5 dBm */
		14520  /*   6 dBm */
		16000  /*   7 dBm */
		16740  /*   8 dBm */
		17590  /*   9 dBm */
		18650  /*  10 dBm */
		19940  /*  11 dBm */
		22270  /*  12 dBm */
	>;

	calibration-freqs = <
	470000000
	920000000
	2441000000
	>;

	/* RSSI calibration gain table, LF path, 490MHz */
	rssi-calibration-lf-table =
	/* gain_value noise_figure */
	<(-46) 221>, /* G1 */
	<(-22) 205>, /* G2 */
	<(  2) 190>, /* G3 */
	<( 24) 169>, /* G4 */
	<( 44) 147>, /* G5 */
	<( 63) 130>, /* G6 */
	<( 84) 113>, /* G7 */
	<(104)  87>, /* G8 */
	<(138)  46>, /* G9 */
	<(158)  30>, /* G10 */
	<(181)  18>, /* G11 */
	<(200)  13>, /* G12 boost0 */
	<(196)  13>, /* G12 boost1 */
	<(208)  13>, /* G12 boost2 */
	<(210)  13>, /* G12 boost3 */
	<(211)  13>, /* G12 boost4 */
	<(215)  12>, /* G12 boost5 */
	<(217)  12>, /* G12 boost6 */
	<(218)  12>, /* G12 boost7 */
	<(224)  12>, /* G13 boost0 */
	<(228)  12>, /* G13 boost1 */
	<(231)  12>, /* G13 boost2 */
	<(234)  12>, /* G13 boost3 */
	<(237)  11>, /* G13 boost4 */
	<(238)  11>, /* G13 boost5 */
	<(240)  10>, /* G13 boost6 */
	<(242)  10>; /* G13 boost7 */

	/* RSSI calibration gain table, HF path, 2.4GHz */
	rssi-calibration-hf-table =
	/* gain_value noise_figure */
	<(-58) 240>, /* G1 */
	<(-34) 221>, /* G2 */
	<(-10) 208>, /* G3 */
	<(  7) 190>, /* G4 */
	<( 25) 171>, /* G5 */
	<( 40) 153>, /* G6 */
	<( 53) 137>, /* G7 */
	<( 77) 113>, /* G8 */
	<(102)  89>, /* G9 */
	<(126)  65>, /* G10 */
	<(146)  47>, /* G11 */
	<(163)  34>, /* G12 boost0 */
	<(166)  32>, /* G12 boost1 */
	<(168)  31>, /* G12 boost2 */
	<(170)  30>, /* G12 boost3 */
	<(171)  30>, /* G12 boost4 */
	<(172)  29>, /* G12 boost5 */
	<(176)  26>, /* G12 boost6 */
	<(175)  27>, /* G12 boost7 */
	<(187)  29>, /* G13 boost0 */
	<(190)  29>, /* G13 boost1 */
	<(193)  27>, /* G13 boost2 */
	<(194)  26>, /* G13 boost3 */
	<(195)  26>, /* G13 boost4 */
	<(196)  25>, /* G13 boost5 */
	<(198)  24>, /* G13 boost6 */
	<(199)  24>; /* G13 boost7 */
};
