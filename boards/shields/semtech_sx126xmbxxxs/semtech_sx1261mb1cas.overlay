/*
 * Copyright (c) 2024 Semtech Corporation
 *
 * SPDX-License-Identifier: Apache-2.0
 */

// SX1261MB1CAS commercial name is SX1261DVK1CAS
// PCB ref is e449v01a
// Freq is 923MHz (Region: Asia)

#include "semtech_sx126xmbxxxs_common.dtsi" // Common
#include "semtech_sx126xmb1xxs.dtsi" 		// Specificities for MB1 shields
#include "semtech_sx1261_pa_cfg.dtsi" 		// Specificities for sx1261 version

lora_semtech_sx1261mb1xxs: &lora_semtech_sx126xmbxxxs {
	compatible = "semtech,sx1261-new";

	reg-mode = <SX126X_REG_MODE_DCDC>;

	// TCXO is present on e449v01a
	dio3-as-tcxo-control;
	tcxo-wakeup-time = <8>;
	tcxo-voltage = <SX126X_TCXO_SUPPLY_1_8V>;
};
