/*
 * Copyright (c) 2024 Semtech Corporation
 *
 * SPDX-License-Identifier: Apache-2.0
 */

// SX1262MB2BAS commercial name is SX1262MB2BAS (mbed shield)
// PCB ref is e499v01b
// Freq is 915MHz (Regions: North America / Australia)

#include "semtech_sx126xmbxxxs_common.dtsi" // Common
#include "semtech_sx1262_pa_cfg.dtsi" 		// Specificities for sx1261 version

lora_semtech_sx1262mb2xxs: &lora_semtech_sx126xmbxxxs {
	compatible = "semtech,sx1262-new";
};
