## Kconfig
```kconfig
# General configuration options

# Copyright (c) 2014-2015 Wind River Systems, Inc.
# Copyright (c) 2016 Intel Corporation
# Copyright (c) 2023 Nordic Semiconductor ASA
# SPDX-License-Identifier: Apache-2.0

# This Kconfig file is picked by the Zephyr build system because it is defined
# as the module Kconfig entry point (see zephyr/module.yml). You can browse
# module options by going to Zephyr -> Modules in Kconfig.

rsource "drivers/Kconfig"
rsource "subsys/Kconfig"
```

## boards/shields/semtech_loraplus_expansion_board/Kconfig.shield
```kconfig
# Copyright (c) 2025 Semtech Corporation
# SPDX-License-Identifier: Apache-2.0

config SHIELD_SEMTECH_LORAPLUS_EXPANSION_BOARD
	def_bool $(shields_list_contains,semtech_loraplus_expansion_board)
```

## boards/shields/semtech_lr2021wio/Kconfig.shield
```kconfig
# Copyright (c) 2025 Semtech Corporation
# SPDX-License-Identifier: Apache-2.0

config SHIELD_SEMTECH_LR202wio
	def_bool $(shields_list_contains,semtech_lr2021wio)
```

## boards/shields/semtech_mbed_wio_interface/Kconfig.shield
```kconfig
# Copyright (c) 2025 Semtech Corporation
# SPDX-License-Identifier: Apache-2.0

config SHIELD_SEMTECH_MBED_WIO_INTERFACE
	def_bool $(shields_list_contains,semtech_mbed_wio_interface)
```

## boards/shields/semtech_nrf54l15dk_mbed_interface/Kconfig.shield
```kconfig
# Copyright (c) 2025 Semtech Corporation
# SPDX-License-Identifier: Apache-2.0

config SHIELD_SEMTECH_NRF54L15DK_MBED_INTERFACE
	def_bool $(shields_list_contains,semtech_nrf54l15dk_mbed_interface)
```

## boards/shields/semtech_wio_lr20xx/Kconfig.shield
```kconfig
# Copyright (c) 2025 Semtech Corporation
# SPDX-License-Identifier: Apache-2.0

config SHIELD_SEMTECH_WIO_LR2021
	def_bool $(shields_list_contains,semtech_wio_lr2021)

config SHIELD_SEMTECH_WIOLR2022
	def_bool $(shields_list_contains,semtech_wio_lr2022)
```

## drivers/usp/Kconfig.lr20xx
```kconfig
# Copyright (c) 2024 Semtech Corporation - Félix Piédallu
# SPDX-License-Identifier: Apache-2.0

# LoRa transceiver drivers configuration options

config SEMTECH_LR20XX
	bool "Semtech LR20xx family LoRa transceiver driver"
	default y
	depends on DT_HAS_SEMTECH_LR2021_ENABLED || DT_HAS_SEMTECH_LR2022_ENABLED
	select SPI
	select GPIO
	help
	  Enable driver for the LR20xx family LoRa transceiver driver

if SEMTECH_LR20XX

config SEMTECH_LR20XX_BLE
	bool "Semtech LR20xx support for BLE"
	default n

config LR20XX_HAL_SPI_BUFFER_MAX_LENGTH
	int "Max length of SPI TX/RX buffers"
	default 260
	range 0 65535

endif
```

## dts/bindings/usp/semtech,lr2021.yaml
```yaml
# Copyright (c) 2025 Semtech Corporation
# SPDX-License-Identifier: Apache-2.0

description: Semtech LR2021 LoRa radio module

compatible: "semtech,lr2021"

include: semtech,lr20xx-common.yaml
```

## dts/bindings/usp/semtech,lr2022.yaml
```yaml
# Copyright (c) 2025 Semtech Corporation
# SPDX-License-Identifier: Apache-2.0

description: Semtech LR2022 LoRa radio module

compatible: "semtech,lr2022"

include: semtech,lr20xx-common.yaml
```

## dts/bindings/usp/semtech,lr20xx-common.yaml
```yaml
# Copyright (c) 2024 Semtech Corporation
# SPDX-License-Identifier: Apache-2.0

description: Semtech LR20XX LoRa radio module

include: spi-device.yaml

properties:
  reset-gpios:
    type: phandle-array
    required: true
    description: |
      GPIO connected to the radio's NRESET signal.

      This signal is open-drain, active-low as interpreted by the modem.

  busy-gpios:
    type: phandle-array
    required: true
    description: |
      GPIO connected to the radio's BUSY/DIO0.

      This signal is high when the radio is ready to accept commands, and
      low when it is processing a command.

  reg-mode:
    type: int
    required: true
    enum:
      - 0
      - 2
    description: |
      Configuration of the radio's power regulator mode.

      See constants LR20XX_REG_MODE_* in dt-bindings/usp/lr11xx.h

  hf-clk-out-scaling:
    type: int
    enum: [0, 1, 2, 3, 4, 5, 6, 7, 8, 9, 10, 11, 12, 13, 14, 15]
    required: false
    description: |
      The power of 2 of the scaling divider for the HF clock output on DIOs.

      * 0x00: Division by 1 (32MHz)
      * 0x01: Division by 2 (16MHz)
      * 0x02: Division by 4 (8MHz)
      * ...
      * 0x0F: Division by 32768 (976.5625kHz)

      This is only used if at least one DIO is configured with the function
      LR20XX_SYSTEM_DIO_FUNC_HF_CLK_OUT.

      See constants LR20XX_SYSTEM_HF_CLK_SCALING_* in dt-bindings/usp/lr20xx.h

  # lf-tx-path:
  #   type: int
  #   required: true
  #   enum: [0, 1, 2]
  #   description: |
  #     Configures which low frequency paths are available on the board.

  #     See constants LR20XX_TX_PATH_* in dt-bindings/usp/lr20xx.h

  tcxo-voltage:
    type: int
    required: true
    description: |
      Supply voltage on the radio's VTCXO signal, if enabled.

      See constants LR20XX_SYSTEM_TCXO_CTRL_* in dt-bindings/usp/lr20xx.h

  tcxo-wakeup-time:
    type: int
    required: true
    description: |
      In milliseconds, the wakeup (or stabilization) time of the TCXO used
      by the radio.

      Set this value to 0 to disable the TCXO management feature.

  lf-clk:
    type: int
    required: true
    enum: [0, 1, 2]
    description: |
      Low frequency clock source for the radio.

      See constants LR20XX_LFCLK_* in dt-bindings/usp/lr20xx.h

  pa-ramp-time:
    type: int
    required: false
    enum: [0, 1, 2, 3, 4, 5, 6, 7, 8, 9, 10, 11, 12, 13, 14, 15, 16, 17, 18]
    description: |
      The ramp-up time for the radio PA. 
      If not provided, the driver will use the default, recommended time (48us).
      It is not recommended to modify this value.

  rx-boost-cfg:
    type: int
    required: false
    enum: [0, 1, 2, 3, 4, 5, 6, 7]
    description: |
      The RX boost option, between 0 to 7, to increase RX sensitivity
      at the expense of higher current consumption in RX mode.
      Defaults to 0 if the property isn't present in dts.

  tx-power-offset:
    type: int
    required: false
    description: |
      Board-specific TX Power offset in dB. Defaults to 0 if the property isn't present in dts.
      I.E if when the PA is outputting 14dB but you measure only 12dB at antenna output, 
      the board tx-power-offset will be 2dB. Can alse be negative if antenna outputs higher power
      than PA output (using an active antenna).

      Can be reconfigured at runtime via radio_utilities_set_tx_power_offset.

  tx-power-cfg-lf:
    type: array
    required: true
    description: |
      Low-power, low-frequency board output TX power calibrated configuration,
      from -10dBm to +22dBm (in 1dBm steps).

      An array of 3-element cells is expected. Each cell describes the
      configuration for a particular TX power with the following format:
      <half_power, power amplifier duty cycle, power amplifier selection>.
      This config depends on the board BOM and layout.


  tx-power-cfg-hf:
    type: array
    required: true
    description: |
      High-frequency board output TX power calibrated configuration,
      from -18dBm to +12dBm (in 1dBm steps).

      An array of 3-element cells is expected. Each cell describes the
      configuration for a particular TX power with the following format:
      <half_power, power amplifier duty cycle, power amplifier selection>.
      This config depends on the board BOM and layout.

  # rssi-calibration-lf-offset:
  #   type: int
  #   required: true
  #   description: |
  #     RSSI offset calibration value, for frequencies below 600MHz.

  #     This config depends on the board BOM and layout.
  #     See the LR1110 User Manual, 7.2.15 SetRssiCalibration.

  # rssi-calibration-lf-tune:
  #   type: array
  #   required: true
  #   description: |
  #     RSSI tuning calibration values, for frequencies below 600MHz.

  #     This config depends on the board BOM and layout. Array order is:
  #     G4 G5 G6 G7 G8 G9 G10 G11 G12 G13 G13hp1 G13hp2 G13hp3 G13hp4 G13hp5 G13hp6 G13hp7
  #     See the LR1110 User Manual, 7.2.15 SetRssiCalibration.

  # rssi-calibration-mf-offset:
  #   type: int
  #   required: true
  #   description: |
  #     RSSI offset calibration value, for frequencies between 600MHz and 2GHz.

  #     This config depends on the board BOM and layout.
  #     See the LR1110 User Manual, 7.2.15 SetRssiCalibration.

  # rssi-calibration-mf-tune:
  #   type: array
  #   required: true
  #   description: |
  #     RSSI tuning calibration values, for frequencies between 600MHz and 2GHz.

  #     This config depends on the board BOM and layout. Array order is:
  #     G4 G5 G6 G7 G8 G9 G10 G11 G12 G13 G13hp1 G13hp2 G13hp3 G13hp4 G13hp5 G13hp6 G13hp7
  #     See the LR1110 User Manual, 7.2.15 SetRssiCalibration.

  # rssi-calibration-hf-offset:
  #   type: int
  #   required: true
  #   description: |
  #     RSSI offset calibration value, for frequencies over 2GHz.

  #     This config depends on the board BOM and layout.
  #     See the LR1110 User Manual, 7.2.15 SetRssiCalibration.

  # rssi-calibration-hf-tune:
  #   type: array
  #   required: true
  #   description: |
  #     RSSI tuning calibration values, for frequencies over 2GHz.

  #     This config depends on the board BOM and layout. Array order is:
  #     G4 G5 G6 G7 G8 G9 G10 G11 G12 G13 G13hp1 G13hp2 G13hp3 G13hp4 G13hp5 G13hp6 G13hp7
  #     See the LR1110 User Manual, 7.2.15 SetRssiCalibration.

  tx-dbm-to-ua-reg-mode-dcdc-lf-vreg:
    type: array
    required: true
    description: |
      Mapping of the current consumption, in microamperes, for each TX power, on low-frequency path.
      Using DC-DC regulator and VReg as supply.

  tx-dbm-to-ua-reg-mode-ldo-lf-vreg:
    type: array
    required: true
    description: |
      Mapping of the current consumption, in microamperes, for each TX power, on low-frequency path.
      Using LDO regulator and VReg as supply.

  tx-dbm-to-ua-reg-mode-dcdc-hf-vreg:
    type: array
    required: true
    description: |
      Mapping of the current consumption, in microamperes, for each TX power, on high-frequency path.
      Using DC-DC regulator and VReg as supply.

  rx-bw-to-ua-reg-mode-dcdc-lf-vreg:
    type: array
    required: true

  rx-bw-to-ua-reg-mode-dcdc-hf-vreg:
    type: array
    required: true

  rx-bw-to-ua-reg-mode-dcdc-lf-vreg-boosted:
    type: array
    required: true

  rx-bw-to-ua-reg-mode-dcdc-hf-vreg-boosted:
    type: array
    required: true

  rx-bw-to-ua-reg-mode-ldo-lf-vreg:
    type: array
    required: true

  rx-bw-to-ua-reg-mode-ldo-hf-vreg:
    type: array
    required: true

  rx-bw-to-ua-reg-mode-ldo-lf-vreg-boosted:
    type: array
    required: true

  rx-bw-to-ua-reg-mode-ldo-hf-vreg-boosted:
    type: array
    required: true

  calibration-freqs:
    type: array
    required: true
    description: |
      An array of 3 frequency calibration values for LR2021 different frequency bands.
      Frequency[0] is (430 MHZ - 510 MHz)
      Frequency[1] is (867 MHZ - 928 MHz)
      Frequency[2] is (2.403 GHZ - 2.479 GHz)
```

## dts/bindings/usp/semtech,lr20xx-dios.yaml
```yaml
description: |
  This binding is used to describe the LR20xx DIOs configuration.

  Here is an example:
  dios {
      dio@5 {
          reg = <5>;
          function = <LR20XX_SYSTEM_DIO_FUNC_RF_SWITCH>;
          sleep-drive = <LR20XX_SYSTEM_DIO_DRIVE_PULL_UP>;
          rf-sw = <(LR20XX_DIO_RF_SWITCH_WHEN_LF_RX | LR20XX_DIO_RF_SWITCH_WHEN_HF_TX)>;
      };
      dio@6 {
          reg = <6>;
          function = <LR20XX_SYSTEM_DIO_FUNC_RF_SWITCH>;
          sleep-drive = <LR20XX_SYSTEM_DIO_DRIVE_AUTO>;
          rf-sw = <(
              LR20XX_DIO_RF_SWITCH_WHEN_LF_RX | LR20XX_DIO_RF_SWITCH_WHEN_LF_TX |
              LR20XX_DIO_RF_SWITCH_WHEN_HF_RX | LR20XX_DIO_RF_SWITCH_WHEN_HF_TX
          )>;
      };
      dio@9 {
          reg = <9>;
          function = <LR20XX_SYSTEM_DIO_FUNC_IRQ>;
          dio-gpios = <&arduino_header 11 (GPIO_ACTIVE_HIGH | GPIO_PULL_DOWN)>;
          irq-mask = <LR20XX_SYSTEM_IRQ_ALL_MASK>;
      };
  };

compatible: "semtech,lr20xx-dios"

include: "base.yaml"

properties:
  "#address-cells":
    const: 1

  "#size-cells":
    const: 0


child-binding:
  description: Semtech LR20XX LoRa radio module DIO Digital I/O description

  properties:
    reg:
      type: int
      required: true
      enum: [5, 6, 7, 8, 9, 10, 11]
      description: The radio's DIO number (5 to 11)

    function:
      type: int
      required: true
      description: |
        The function configured on the radio's DIO signal.

        See constants LR20XX_SYSTEM_DIO_FUNC_* in dt-bindings/usp/lr20xx.h

    sleep-drive:
      type: int
      description: |
        The radio's DIO signal can be pulled up or down when sleeping.

        Auto means DIO is pull-up if its last state was 1 and pull-down if it was 0.

        See constants LR20XX_SYSTEM_DIO_DRIVE_* in dt-bindings/usp/lr20xx.h

    irq-mask:
      type: int
      description: |
        A bitmask of the IRQs that should be routed on the radio's DIO signal.

        Only valid if function is LR20XX_SYSTEM_DIO_FUNC_IRQ.

        See constants LR20XX_SYSTEM_IRQ_* in dt-bindings/usp/lr20xx.h

    dio-gpios:
      type: phandle-array
      description: |
        GPIO connected to the radio's DIO signal. This GPIO will be used as a
        generic IRQ line from the chip.

        Only valid if function is LR20XX_SYSTEM_DIO_FUNC_IRQ.

    rf-sw:
      type: int
      description: |
        A bitmask of the RF modes when the DIO needs to be asserted.

        Only valid if function is LR20XX_SYSTEM_DIO_FUNC_RF_SWITCH.

        See constants LR20XX_DIO_RF_SWITCH_WHEN_* in dt-bindings/usp/lr20xx.h
```

## modules/Kconfig
```kconfig
# Copyright (c) 2019 Intel Corporation
# SPDX-License-Identifier: Apache-2.0

comment "USP module not available."
	depends on !ZEPHYR_USP_MODULE

# This ensures that symbols are available in Kconfig for dependency checking
# and referencing, while keeping the settings themselves unavailable when the
# modules are not present in the workspace
if 0
osource "modules/*/Kconfig"
endif
```

## modules/usp/Kconfig
```kconfig
# Copyright (c) 2024 Semtech Corporation
# SPDX-License-Identifier: Apache-2.0

# Top-level configuration file for LoRa Basics Modem containing LoRa
# transceiver drivers and LBM LoRaWAN stack

config ZEPHYR_USP_MODULE
	bool
```

## subsys/Kconfig
```kconfig
# Subsystem configuration options

# SPDX-License-Identifier: Apache-2.0

menu "Subsystems and OS Services"

rsource "usp/Kconfig"
rsource "lbm/Kconfig"

endmenu
```
